## Kconfig
```kconfig
menu "on9rstore"

    config ON9RSTORE_SPARSE_FILE_SIZE
        int "Sparse data file size in bytes"
        default 1048576
        range 65536 2147483647
        help
            Fixed size of each preallocated contiguous data_N.db file.
            The default is 1 MiB for NOR-flash testing.
            The value must be a multiple of 4096 bytes.

    config ON9STORE_SPARSE_FILE_CNT
        int "Sparse data file count"
        default 5
        range 2 9999
        help
            Number of permanent preallocated contiguous data_N.db files.

    config ON9RSTORE_TIME_ANCHOR_CNT
        int "Manifest time-anchor entry count"
        default 512
        range 1 65535
        help
            Number of 512-byte time-anchor slots in manifest.db.
            Existing stores use the count persisted in their superblock even
            when a later firmware build selects a different value.

endmenu
```

## test_app/sdkconfig.defaults
```kconfig
CONFIG_PARTITION_TABLE_CUSTOM=y
CONFIG_PARTITION_TABLE_CUSTOM_FILENAME="partition_table.csv"
CONFIG_WL_SECTOR_SIZE=4096
CONFIG_ON9RSTORE_SPARSE_FILE_SIZE=65536
CONFIG_ON9STORE_SPARSE_FILE_CNT=3
CONFIG_ON9RSTORE_TIME_ANCHOR_CNT=8
CONFIG_ESPTOOLPY_FLASHSIZE_4MB=y
CONFIG_ESP_MAIN_TASK_STACK_SIZE=8192
CONFIG_UNITY_ENABLE_64BIT=y
```
